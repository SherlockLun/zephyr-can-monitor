## CMakeLists.txt
```
cmake_minimum_required(VERSION 3.20.0)
find_package(Zephyr REQUIRED HINTS $ENV{ZEPHYR_BASE})
project(test_can_monitor)

# Resolve absolute path to the application sources
get_filename_component(APP_ROOT "${CMAKE_CURRENT_SOURCE_DIR}/../../.." ABSOLUTE)

target_sources(app PRIVATE
    src/test_can_monitor.c
    ${APP_ROOT}/src/can_monitor.c
    ${APP_ROOT}/src/logger.c
)

target_include_directories(app PRIVATE
    ${APP_ROOT}/src
)
```

## Kconfig
```
mainmenu "CAN Monitor unit tests (default)"

source "Kconfig.zephyr"

rsource "../../../Kconfig.appsymbols"
```

## prj.conf
```kconfig
# ---- Test: can_monitor (default config — no optional IDs) ----
CONFIG_ZTEST=y
CONFIG_ZTEST_ASSERT_VERBOSE=1

# CAN subsystem with fake driver (no real hardware needed)
CONFIG_CAN=y

# Random generator for native_sim
CONFIG_TEST_RANDOM_GENERATOR=y

# Console
CONFIG_PRINTK=y
CONFIG_UART_CONSOLE=y

# No optional RX IDs → logger starts in LOGGING_ACTIVE
# CONFIG_CAN_ID_START_ENABLED is not set
# CONFIG_CAN_ID_STOP_ENABLED  is not set
# CONFIG_CAN_ID_HELLO_ENABLED is not set
```

## src/test_can_monitor.c
```c
#include <zephyr/ztest.h>
#include <zephyr/drivers/can.h>
#include <string.h>

#include "can_monitor.h"

struct monitor_fixture {
	const struct device *can_dev;
};

static void *suite_setup(void)
{
	static struct monitor_fixture f;

	f.can_dev = DEVICE_DT_GET(DT_CHOSEN(zephyr_canbus));
	zassert_true(device_is_ready(f.can_dev),
		     "Fake CAN device not ready");

	return &f;
}

static void before_each(void *data)
{
	ARG_UNUSED(data);
	struct monitor_fixture *f = (struct monitor_fixture *)data;

	can_monitor_init(f->can_dev);
}

ZTEST_SUITE(can_monitor_default, NULL, suite_setup, before_each, NULL, NULL);

static struct can_frame make_frame(uint32_t id)
{
	struct can_frame f;

	memset(&f, 0, sizeof(f));
	f.id  = id;
	f.dlc = 2;
	f.data[0] = 0xAB;
	f.data[1] = 0xCD;
	return f;
}

ZTEST(can_monitor_default, test_initial_state_is_active)
{
	zassert_equal(can_monitor_get_state(), LOGGING_ACTIVE,
		      "Expected LOGGING_ACTIVE on startup (no start ID)");
}

ZTEST(can_monitor_default, test_frame_logged_when_active)
{
	zassert_equal(can_monitor_get_state(), LOGGING_ACTIVE, "pre-cond");

	struct can_frame f = make_frame(0x042);
	can_monitor_dispatch(&f);

	zassert_equal(can_monitor_get_log_count(), 1U,
		      "Frame should have been logged");
}

ZTEST(can_monitor_default, test_multiple_frames_logged)
{
	struct can_frame f = make_frame(0x010);

	can_monitor_dispatch(&f);
	can_monitor_dispatch(&f);
	can_monitor_dispatch(&f);

	zassert_equal(can_monitor_get_log_count(), 3U,
		      "All three frames should be logged");
}

ZTEST(can_monitor_default, test_log_count_zero_after_reset)
{
	struct can_frame f = make_frame(0x001);

	can_monitor_dispatch(&f);
	zassert_equal(can_monitor_get_log_count(), 1U, "one frame logged");

	can_monitor_reset();
	zassert_equal(can_monitor_get_log_count(), 0U,
		      "log_count reset to 0");
}

ZTEST(can_monitor_default, test_hello_count_initially_zero)
{
	zassert_equal(can_monitor_get_hello_count(), 0U,
		      "hello_count should be 0 at init");
}

ZTEST(can_monitor_default, test_no_hello_without_hello_id)
{
	struct can_frame f = make_frame(0x202);

	can_monitor_dispatch(&f);

	zassert_equal(can_monitor_get_hello_count(), 0U,
		      "hello_count must stay 0 when HELLO_ID disabled");
	zassert_equal(can_monitor_get_log_count(), 1U,
		      "Frame logged normally (not treated as HELLO)");
}
```
