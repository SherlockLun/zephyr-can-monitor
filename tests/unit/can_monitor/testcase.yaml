## tests/unit/can_monitor/testcase.yaml
```yaml
tests:
  can_monitor.default:
    tags: can monitor state_machine
    platform_allow:
      - native_sim
      - native_sim/native/64
    timeout: 30
    harness: ztest
    harness_config:
      type: one_line
      regex:
        - "PROJECT EXECUTION SUCCESSFUL"
```

## tests/unit/can_monitor_start_stop/testcase.yaml
```yaml
tests:
  can_monitor.start_stop:
    tags: can monitor state_machine start_stop hello
    platform_allow:
      - native_sim
      - native_sim/native/64
    timeout: 30
    harness: ztest
    harness_config:
      type: one_line
      regex:
        - "PROJECT EXECUTION SUCCESSFUL"
```

## tests/unit/can_tx/testcase.yaml
```yaml
tests:
  can_tx.periodic:
    tags: can tx periodic
    platform_allow:
      - native_sim
      - native_sim/native/64
    timeout: 30
    harness: ztest
    harness_config:
      type: one_line
      regex:
        - "PROJECT EXECUTION SUCCESSFUL"
```

## tests/unit/logger/testcase.yaml
```yaml
tests:
  logger.format:
    tags: logger format uart
    platform_allow:
      - native_sim
      - native_sim/native/64
    timeout: 15
    harness: ztest
    harness_config:
      type: one_line
      regex:
        - "PROJECT EXECUTION SUCCESSFUL"
```
